## components/tamp/Kconfig
```kconfig
menu "tamp"

	config TAMP_ESP32
	bool "Use ESP-optimized code for compression"
	default y
	help
		Enables TAMP_ESP32 (ESP32 speed optimizations).
		On ESP32-S3, this also enables use of the chip's SIMD instructions ("PIE")
		for increased speed.

	config TAMP_ESP32_AUTO_RESET_TASK_WDT
	bool "Automatically reset task watch dog timer."
	depends on TAMP_ESP32
	default n
	help
		Automatically resets the task watchdog-timer after every compression cycle.

endmenu
```

## resources/tools/buildTime/sdkconfig.defaults
```kconfig
CONFIG_FREERTOS_HZ=1000
CONFIG_BT_ENABLED=y
CONFIG_BT_CLASSIC_ENABLED=y
CONFIG_BT_SPP_ENABLED=y
CONFIG_AUTOSTART_ARDUINO=y
CONFIG_BOOTLOADER_COMPILER_OPTIMIZATION_SIZE=y
CONFIG_COMPILER_OPTIMIZATION_SIZE=y
CONFIG_PARTITION_TABLE_CUSTOM=y
CONFIG_PARTITION_TABLE_CUSTOM_FILENAME="resources/tools/fs/in/partitions.csv"
CONFIG_PARTITION_TABLE_FILENAME="resources/tools/fs/in/partitions.csv"
CONFIG_PARTITION_TABLE_OFFSET=0x19000
CONFIG_PARTITION_TABLE_MD5=y
CONFIG_ESPTOOLPY_FLASHSIZE="4MB"
CONFIG_ESPTOOLPY_FLASHSIZE_4MB=y
CONFIG_ESPTOOLPY_FLASHFREQ="80m"
CONFIG_ESPTOOLPY_FLASHFREQ_80M=y
CONFIG_ESPTOOLPY_FLASHMODE_QIO=y
CONFIG_BOOTLOADER_WDT_TIME_MS=20000
CONFIG_ESP_TASK_WDT_TIMEOUT_S=25
CONFIG_INT_WDT_TIMEOUT_MS=3000
CONFIG_TASK_WDT_TIMEOUT_S=25

#CONFIG_BOOTLOADER_SKIP_VALIDATE_IN_DEEP_SLEEP=y
#CONFIG_BOOTLOADER_SKIP_VALIDATE_ON_POWER_ON=y
# Sadly no because of
#/home/szybet/.platformio/packages/toolchain-xtensa-esp32/bin/../lib/gcc/xtensa-esp32-elf/12.2.0/../../../../xtensa-esp32-elf/bin/ld: .pio/build/min/firmware.elf section `.rtc_fast_reserved' will not fit in region `rtc_fast_reserved_seg'
#/home/szybet/.platformio/packages/toolchain-xtensa-esp32/bin/../lib/gcc/xtensa-esp32-elf/12.2.0/../../../../xtensa-esp32-elf/bin/ld: RTC FAST reserved segment data does not fit.
#/home/szybet/.platformio/packages/toolchain-xtensa-esp32/bin/../lib/gcc/xtensa-esp32-elf/12.2.0/../../../../xtensa-esp32-elf/bin/ld: region `rtc_fast_reserved_seg' overflowed by 16 bytes

CONFIG_ARDUINO_RUN_NO_AFFINITY=y
CONFIG_ARDUINO_RUNNING_CORE=-1
CONFIG_ARDUINO_LOOP_STACK_SIZE=16384
CONFIG_ARDUINO_EVENT_RUN_NO_AFFINITY=y
CONFIG_ARDUINO_EVENT_RUNNING_CORE=-1
CONFIG_ARDUINO_SERIAL_EVENT_TASK_PRIORITY=12
CONFIG_ARDUHAL_PARTITION_SCHEME_NO_OTA=y
CONFIG_ARDUHAL_PARTITION_SCHEME="no_ota"
CONFIG_PM_ENABLE=y
CONFIG_PM_UPDATE_CCOMPARE_HLI_WORKAROUND=y
CONFIG_ESP_DEFAULT_CPU_FREQ_MHZ_80=y
CONFIG_ESP_DEFAULT_CPU_FREQ_MHZ=80
CONFIG_MBEDTLS_PSK_MODES=y
CONFIG_MBEDTLS_KEY_EXCHANGE_DHE_PSK=y
CONFIG_MBEDTLS_KEY_EXCHANGE_ECDHE_PSK=y
CONFIG_MBEDTLS_KEY_EXCHANGE_RSA_PSK=y
CONFIG_ESP_COREDUMP_ENABLE_TO_FLASH=y
CONFIG_ESP_COREDUMP_DATA_FORMAT_BIN=y
CONFIG_ESP_COREDUMP_CHECKSUM_CRC32=y
CONFIG_ESP_COREDUMP_ENABLE=y
CONFIG_ESP_COREDUMP_MAX_TASKS_NUM=64
CONFIG_ESP_COREDUMP_STACK_SIZE=0
CONFIG_FREERTOS_TASK_FUNCTION_WRAPPER=y
CONFIG_LOG_DEFAULT_LEVEL_ERROR=y
CONFIG_LOG_DEFAULT_LEVEL=1
CONFIG_LOG_MAXIMUM_LEVEL=1
CONFIG_LOG_COLORS=n
CONFIG_LITTLEFS_MTIME_USE_SECONDS=n
CONFIG_LITTLEFS_USE_MTIME=n
```

## resources/tools/sdkconfigs/sdkconfig.defaults
```kconfig
CONFIG_FREERTOS_HZ=1000
CONFIG_BT_ENABLED=y
CONFIG_BT_CLASSIC_ENABLED=y
CONFIG_BT_SPP_ENABLED=y
CONFIG_AUTOSTART_ARDUINO=y
CONFIG_BOOTLOADER_COMPILER_OPTIMIZATION_SIZE=y
CONFIG_COMPILER_OPTIMIZATION_SIZE=y
CONFIG_MBEDTLS_PSK_MODES=y
# CONFIG_MBEDTLS_KEY_EXCHANGE_PSK is not set
CONFIG_MBEDTLS_KEY_EXCHANGE_DHE_PSK=y
CONFIG_MBEDTLS_KEY_EXCHANGE_ECDHE_PSK=y
CONFIG_MBEDTLS_KEY_EXCHANGE_RSA_PSK=y
CONFIG_PARTITION_TABLE_CUSTOM=y
CONFIG_PARTITION_TABLE_CUSTOM_FILENAME="resources/tools/fs/in/partitions.csv"
CONFIG_PARTITION_TABLE_FILENAME="resources/tools/fs/in/partitions.csv"
CONFIG_PARTITION_TABLE_OFFSET=0x50000
CONFIG_PARTITION_TABLE_MD5=y
CONFIG_ESPTOOLPY_FLASHSIZE="4MB"
CONFIG_ESPTOOLPY_FLASHSIZE_4MB=y
CONFIG_ESPTOOLPY_FLASHFREQ="80m"
CONFIG_ESPTOOLPY_FLASHFREQ_80M=y
CONFIG_ESPTOOLPY_FLASHMODE_QIO=y
```
