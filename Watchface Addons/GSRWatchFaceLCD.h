RTC_DATA_ATTR int MyGSRLCDFace;  // Watchface ID #.
// Approx. 3035 bytes

// https://www.1001freefonts.com/transponder.font
const uint8_t TRAN48pt7bBitmaps[] PROGMEM = {
  0x00, 0x0F, 0xFF, 0x83, 0xFF, 0xE0, 0x3F, 0xFF, 0x8F, 0xFF, 0xE0, 0xBF,
  0xFF, 0x0F, 0xFF, 0x93, 0xBF, 0xFC, 0x0F, 0xFE, 0x7F, 0x00, 0x00, 0x00,
  0x01, 0xFE, 0x00, 0x00, 0x00, 0x3B, 0xFC, 0x00, 0x00, 0x00, 0xF7, 0xF8,
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  0x00, 0x46, 0xFF, 0xFF, 0xFF, 0x62 };

const GFXglyph TRAN48pt7bGlyphs[] PROGMEM = {
  {     0,   1,   1,  44,    0,    0 },   // 0x20 ' '
  {     0,   0,   0,   0,    0,    0 },   // 0x21 '!'
  {     0,   0,   0,   0,    0,    0 },   // 0x22 '"'
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  {  3106,   4,  40,   9,    1,  -41 } }; // 0x3A ':'

const GFXfont TRAN48pt7b PROGMEM = {
  (uint8_t  *)TRAN48pt7bBitmaps,
  (GFXglyph *)TRAN48pt7bGlyphs,
  0x20, 0x3A, 113 };

// Approx. 3322 bytes

const uint8_t TRAN19pt7bBitmaps[] PROGMEM = {
  0x00, 0xFF, 0xFF, 0xFF, 0x00, 0x00, 0x0F, 0xC0, 0xC1, 0xE0, 0xF0, 0x78,
  0x3C, 0x1E, 0x0F, 0x06, 0x03, 0x0C, 0x0C, 0x30, 0x30, 0xC0, 0xC3, 0x03,
  0x0C, 0x0C, 0x30, 0x30, 0xC0, 0xC3, 0x03, 0x0C, 0x0C, 0x30, 0x30, 0xC0,
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  0x83, 0xC1, 0x83, 0xC1, 0xFF, 0x00, 0x7C };

const GFXglyph TRAN19pt7bGlyphs[] PROGMEM = {
  {     0,   1,   1,  18,    0,    0 },   // 0x20 ' '
  {     1,   2,  25,   3,    0,  -25 },   // 0x21 '!'
  {     8,   9,   7,  10,    0,  -25 },   // 0x22 '"'
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  {  3735,  16,  14,  18,    1,  -26 } }; // 0x7E '~'

const GFXfont TRAN19pt7b PROGMEM = {
  (uint8_t  *)TRAN19pt7bBitmaps,
  (GFXglyph *)TRAN19pt7bGlyphs,
  0x20, 0x7E, 45 };

// Approx. 4435 bytes

const uint8_t TRAN6pt7bBitmaps[] PROGMEM = {
  0xDC, 0x63, 0xB8, 0xC6, 0x31, 0xCE, 0xFF, 0x18, 0xC6, 0x31 };

const GFXglyph TRAN6pt7bGlyphs[] PROGMEM = {
  {     0,   5,   8,   6,    0,   -7 },   // 0x41 'A'
  {     0,   0,   0,   0,    0,    0 },   // 0x42 'B'
  {     0,   0,   0,   0,    0,    0 },   // 0x43 'C'
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  {     5,   5,   8,   6,    0,   -7 } }; // 0x4D 'M'

const GFXfont TRAN6pt7b PROGMEM = {
  (uint8_t  *)TRAN6pt7bBitmaps,
  (GFXglyph *)TRAN6pt7bGlyphs,
  0x41, 0x4D, 14 };

class GSRWatchFaceLCD : public WatchyGSR {
    public:
    GSRWatchFaceLCD() : WatchyGSR() { initAddOn(this); } // *** DO NOT EDIT THE CONTENTS OF THIS FUNCTION ***

    void RegisterWatchFaces(){  // Add WatchStyles here (this is done pre-boot, post init)
        MyGSRLCDFace = AddWatchStyle("LCD",this);
   };

    void InsertInitWatchStyle(uint8_t StyleID){
      if (StyleID == MyGSRLCDFace){ // LCD
          Design.Menu.Top = 56;
          Design.Menu.Header = 25;
          Design.Menu.Data = 66;
          Design.Menu.Gutter = 3;
          Design.Menu.Font = &aAntiCorona12pt7b;
          Design.Menu.FontSmall = &aAntiCorona11pt7b;
          Design.Menu.FontSmaller = &aAntiCorona10pt7b;
          Design.Face.Bitmap = nullptr;
          Design.Face.SleepBitmap = nullptr;
          Design.Face.Gutter = 4;
          Design.Face.Time = 134;
          Design.Face.TimeHeight = 48;
          Design.Face.TimeColor = GSR_AutoFore;
          Design.Face.TimeFont = &TRAN48pt7b;
          Design.Face.TimeLeft = 0;
          Design.Face.TimeStyle = WatchyGSR::dCENTER;
          Design.Face.Day = 44;
          Design.Face.DayGutter = 4;
          Design.Face.DayColor = GSR_AutoFore;
          Design.Face.DayFont = &TRAN19pt7b;
          Design.Face.DayFontSmall = &TRAN19pt7b;
          Design.Face.DayFontSmaller = &TRAN19pt7b;
          Design.Face.DayLeft = 0;
          Design.Face.DayStyle = WatchyGSR::dCENTER;
          Design.Face.Date = 170;
          Design.Face.DateGutter = 4;
          Design.Face.DateColor = GSR_AutoFore;
          Design.Face.DateFont = &TRAN19pt7b;
          Design.Face.DateFontSmall = &TRAN19pt7b;
          Design.Face.DateFontSmaller = &TRAN19pt7b;
          Design.Face.DateLeft = 0;
          Design.Face.DateStyle = WatchyGSR::dLEFT;
          Design.Face.Year = 170;
          Design.Face.YearLeft = 99;
          Design.Face.YearColor = GSR_AutoFore;
          Design.Face.YearFont = &TRAN19pt7b;
          Design.Face.YearLeft = 0;
          Design.Face.YearStyle = WatchyGSR::dRIGHT;
          Design.Status.WIFIx = 5;
          Design.Status.WIFIy = 193;
          Design.Status.BATTx = 155;
          Design.Status.BATTy = 178;
       }
    };

    void InsertDrawWatchStyle(uint8_t StyleID){
      uint8_t X, Y;
      uint16_t A;
      if (StyleID == MyGSRLCDFace){
           if (SafeToDraw()){
                if (NoMenu()){
                    drawTime(96); // Pad + no AM.
                    if (IsAM()){
                        display.setFont(&TRAN6pt7b);
                        setFontColor(Design.Face.TimeColor);
                        display.setCursor(180, Design.Face.Time - (Design.Face.TimeHeight + 22));
                        display.print("AM");
                    }
                }
                drawDay();
                drawYear();
                drawDate(true); // Short month only.
                drawWeather();
            }
       }
    };
};

GSRWatchFaceLCD MyGSRLCD;
